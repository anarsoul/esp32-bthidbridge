## main/Kconfig.projbuild
```kconfig
menu "BT HID Bridge Configuration"
    config BRIDGE_SSP_ENABLED
        bool "Secure Simple Pairing"
        depends on BT_CLASSIC_ENABLED
        default y
        help
            Enable Secure Simple Pairing for Classic BT connections.
            Disable to fall back to legacy pairing with PIN code.

    config BRIDGE_PEER_DEVICE_NAME
        string "BLE HID device name filter"
        default ""
        help
            If set, only connect to a BLE HID device whose advertised name
            matches this string exactly. Leave empty to connect to the first
            BLE HID device found during scanning.

    config BRIDGE_BT_DEVICE_NAME
        string "Classic BT device name advertised to host"
        default "ESP32 HID Bridge"
        help
            The name the bridge presents when discoverable over Classic BT.

    config BRIDGE_AUTO_RECONNECT
        bool "Reconnect to BLE device after disconnect"
        default y
        help
            When the BLE HID device disconnects, automatically restart
            scanning and reconnect.

    config BRIDGE_BLE_MAX_CONN_INTERVAL
        int "BLE connection max interval (units of 1.25 ms)"
        default 12
        range 6 160
        help
            Maximum BLE connection interval requested after connecting to the
            HID peripheral, in units of 1.25 ms. Common values: 6 (7.5 ms),
            8 (10 ms), 12 (15 ms), 16 (20 ms). Lower values reduce BLE
            latency but increase power consumption on the peripheral. The
            peripheral may negotiate a higher value if its firmware requires it.

    config BRIDGE_FORWARD_INTERVAL_MS
        int "Classic BT HID forward interval (ms)"
        default 5
        range 5 100
        help
            Minimum interval between HID report forwards to the Classic BT host.
            Reports arriving faster than this are coalesced; only the latest is sent.
            10ms = 100Hz, suitable for hosts that poll Classic BT at ~100Hz (e.g. Tesla).

    config BRIDGE_LOG_AXES
        bool "Log analog axis values on change"
        default n
        help
            Log LX/LY/RX/RY axis values whenever the HID report changes.
            Useful for debugging stuck controls; disable in production.

    config BRIDGE_LATENCY_MEASURE
        bool "Measure HID forwarding latency"
        default n
        help
            Log internal latency between receiving a BLE HID report and
            forwarding it to the Classic BT stack. Min/max/avg are reported
            every 100 forwarded reports. Disable in production.

    config BRIDGE_LED_ENABLE
        bool "Enable status LED"
        default y
        help
            Drive a GPIO pin as a status LED.
            Fast blink: waiting for BLE controller.
            Slow blink: BLE connected, waiting for Classic BT host.
            Solid on: both BLE and Classic BT connected.

    config BRIDGE_LED_GPIO
        int "Status LED GPIO number"
        depends on BRIDGE_LED_ENABLE
        default 13
        help
            GPIO pin connected to the status LED.
            GPIO2 is the built-in LED on ESP32 WROOM modules.
endmenu
```

## sdkconfig.defaults
```kconfig
CONFIG_BT_ENABLED=y
CONFIG_BTDM_CTRL_MODE_BTDM=y
CONFIG_BT_BLUEDROID_ENABLED=y
CONFIG_BT_CLASSIC_ENABLED=y
CONFIG_BT_BLE_ENABLED=y
CONFIG_BT_HID_ENABLED=y
CONFIG_BT_HID_DEVICE_ENABLED=y
CONFIG_BT_HID_HOST_ENABLED=y
CONFIG_BT_GATTC_ENABLE=y
CONFIG_BT_GATTC_NOTIF_REG_MAX=16
CONFIG_BT_SDP_COMMON_ENABLED=y
CONFIG_BT_SDP_ATTR_LEN=512
CONFIG_BT_SDP_PAD_LEN=512
CONFIG_BT_BLE_42_FEATURES_SUPPORTED=y
CONFIG_PARTITION_TABLE_SINGLE_APP_LARGE=y
CONFIG_ESP32_DEFAULT_CPU_FREQ_240=y
```
